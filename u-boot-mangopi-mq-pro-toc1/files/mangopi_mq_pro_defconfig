## u-boot-mangopi-mq-pro-toc1/files/mangopi_mq_pro_defconfig
```kconfig
CONFIG_RISCV=y
CONFIG_DEFAULT_DEVICE_TREE="sun20i-d1-mangopi-mq-pro"
CONFIG_TARGET_SUNXI=y
CONFIG_ARCH_RV64I=y
CONFIG_RISCV_SMODE=y
# CONFIG_SPL_SMP is not set
CONFIG_SYS_LOAD_ADDR=0x4a000000
CONFIG_CMD_CLK=y
CONFIG_CMD_GPIO=y
CONFIG_CMD_I2C=y
CONFIG_CMD_LSBLK=y
CONFIG_CMD_SPI=y
CONFIG_CMD_WDT=y
CONFIG_CMD_TIMER=y
CONFIG_CMD_REGULATOR=y
CONFIG_NET_RANDOM_ETHADDR=y
CONFIG_PHY_REALTEK=y
CONFIG_SUN8I_EMAC=y
CONFIG_DM_REGULATOR_FIXED=y
CONFIG_SPI=y
CONFIG_USB=y
CONFIG_DM_USB_GADGET=y
CONFIG_USB_MUSB_GADGET=y
CONFIG_USB_GADGET=y
CONFIG_USB_GADGET_DOWNLOAD=y
CONFIG_USB_FUNCTION_MASS_STORAGE=y
```

## u-boot-mangopi-mq-pro/files/mangopi_mq_pro_defconfig
```kconfig
CONFIG_RISCV=y
CONFIG_DEFAULT_DEVICE_TREE="sun20i-d1-mangopi-mq-pro"
CONFIG_TARGET_SUN20I_D1=y
CONFIG_ARCH_RV64I=y
CONFIG_RISCV_SMODE=y
# CONFIG_SPL_SMP is not set
CONFIG_SYS_SPL_MALLOC=y
CONFIG_SPL_OPENSBI_SCRATCH_OPTIONS=0x0
# CONFIG_SYS_I2C_MVTWSI is not set
CONFIG_DM_REGULATOR_FIXED=y
```

## u-boot-milkv-duo/patches/patch-configs_cvitek__cv1800b__milkv__duo__sd__defconfig
```kconfig
$NetBSD$

--- configs/cvitek_cv1800b_milkv_duo_sd_defconfig.orig	2024-10-26 09:15:12.136486987 +0000
+++ configs/cvitek_cv1800b_milkv_duo_sd_defconfig
@@ -30,6 +30,7 @@ CONFIG_BOOTM_OPENRTOS=y
 # CONFIG_BOOTM_PLAN9 is not set
 # CONFIG_BOOTM_RTEMS is not set
 # CONFIG_BOOTM_VXWORKS is not set
+CONFIG_CMD_BOOTEFI=y
 # CONFIG_CMD_ELF is not set
 # CONFIG_CMD_FDT is not set
 # CONFIG_CMD_GO is not set
@@ -76,7 +77,7 @@ CONFIG_FAT_WRITE=y
 # CONFIG_REGEX is not set
 CONFIG_LZMA=y
 # CONFIG_GZIP is not set
-# CONFIG_EFI_LOADER is not set
+CONFIG_EFI_LOADER=y
 # CONFIG_TOOLS_LIBCRYPTO is not set
 # CONFIG_ENV_SUPPORT is not set
 # CONFIG_ENV_OVERWRITE is not set
```
